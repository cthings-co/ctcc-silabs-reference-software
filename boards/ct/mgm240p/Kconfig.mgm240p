## boards/ct/mgm240p/board.yml
```yaml
board:
  name: mgm240p
  full_name: CTHINGS MGM240P
  vendor: ct
  socs:
    - name: mgm240pa32vnn
```

## dts/bindings/gpio/ct,mgm240p-signals.yaml
```yaml
description: CTHINGS MGM240P board signals

compatible: "ct,mgm240p-signals"

properties:
  w-disable-gpios:
    type: phandle-array
    required: true
    description: W_DISABLE signal

  coex1-gpios:
    type: phandle-array
    required: true
    description: COEX1 signal

  coex2-gpios:
    type: phandle-array
    required: true
    description: COEX2 signal
```

## west.yml
```yaml
# Copyright (c) 2026 CTHINGS.CO
# SPDX-License-Identifier: Apache-2.0

manifest:
  remotes:
    - name: silabs
      url-base: https://github.com/SiliconLabsSoftware

  projects:
    - name: zephyr-silabs
      remote: silabs
      revision: v2026.6.0
      import: true

  self:
    path: ctcc-silabs-reference-software
```
